// SPDX-License-Identifier: (GPL-2.0 OR MIT)
/* Copyright (c) 2020-2021 Microchip Technology Inc */

/dts-v1/;
/plugin/;

&{/chosen} {
	overlays {
		PCIE-M2-GATEWARE = "GATEWARE_GIT_VERSION";
	};
};

&pcie {
	status = "okay";
};
